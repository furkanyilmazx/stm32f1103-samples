#include <stm32f10x.h>
#include <stm32f10x_rcc.h>
#include <stm32f10x_gpio.h>
#include <stm32f10x_spi.h>
#include <stm32f10x_tim.h>

#define CS_PIN 	GPIO_Pin_5
#define DC_PIN 	GPIO_Pin_6
#define RST_PIN GPIO_Pin_7


static uint8_t buffer[1024] = { 
0x00, 0x00, 0x00, 0x00, 0x00, 0x00, 0x00, 0x00, 0x00, 0x00, 0x00, 0x00, 0x00, 0x00, 0x00, 0x00,
0x00, 0x00, 0x00, 0x05, 0x04, 0x07, 0x00, 0x00, 0x00, 0x00, 0x00, 0x00, 0x00, 0x00, 0x00, 0x00,
0x00, 0x00, 0x00, 0x00, 0x00, 0x00, 0x00, 0x00, 0x00, 0x00, 0x00, 0x00, 0x00, 0x00, 0x00, 0x00,
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0x00, 0x00, 0x00, 0x00, 0x00, 0x00, 0x00, 0x00, 0x00, 0x00, 0x00, 0x00, 0x00, 0x00, 0x00, 0x00
};


void 	delay_MS(uint32_t nCount);
void	init_RCC(void);
void	init_SPI2(void);
void	init_CTRL_GPIO(void);
void	send_data_SPI2(uint8_t data);
void 	send_1Command_SSD1306(uint8_t command);
void 	send_2Command_SSD1306(uint8_t comm1,uint8_t comm2);
void 	send_Data_SSD1306(uint8_t data);
void 	init_SSD1306(void);
void 	display_SSD1306(void);

int main(){

	init_RCC();
	init_CTRL_GPIO();
	init_SPI2();

	init_SSD1306();
	display_SSD1306();
	
	while(1){
	}
}

void delay_MS(uint32_t nCount)
{ 
	uint32_t i;
	nCount = nCount*(SystemCoreClock/5000);
	for(i=0;i<nCount;i++);
}

void init_RCC()
{
	RCC_APB1PeriphClockCmd(RCC_APB1Periph_SPI2, ENABLE);
	RCC_APB2PeriphClockCmd(RCC_APB2Periph_GPIOB | RCC_APB2Periph_GPIOA, ENABLE);
}

void init_SPI2()
{
	GPIO_InitTypeDef GPIO_InitStructure;
	SPI_InitTypeDef  SPI_InitStructure;

	/* SPI2 GPIO configuration -------------------------------------------------------*/
	GPIO_InitStructure.GPIO_Mode = GPIO_Mode_AF_PP;
	GPIO_InitStructure.GPIO_Speed = GPIO_Speed_50MHz;
	GPIO_InitStructure.GPIO_Pin = GPIO_Pin_13 | GPIO_Pin_15;
	GPIO_Init(GPIOB, &GPIO_InitStructure);

	
	/* SPI2 configuration -------------------------------------------------------*/
	SPI_InitStructure.SPI_Direction 		= SPI_Direction_1Line_Tx;
	SPI_InitStructure.SPI_DataSize 			= SPI_DataSize_8b;
	SPI_InitStructure.SPI_CPOL 				= SPI_CPOL_High;
	SPI_InitStructure.SPI_CPHA 				= SPI_CPHA_2Edge;
	SPI_InitStructure.SPI_NSS 				= SPI_NSS_Soft;
	SPI_InitStructure.SPI_BaudRatePrescaler = SPI_BaudRatePrescaler_32;
	SPI_InitStructure.SPI_FirstBit 			= SPI_FirstBit_MSB;
	
	SPI_InitStructure.SPI_Mode 				= SPI_Mode_Master;
	
	
	SPI_Init(SPI2, &SPI_InitStructure);
	
	SPI_Cmd(SPI2, ENABLE);
}

void send_data_SPI2(uint8_t data)
{
	GPIO_ResetBits(GPIOA, CS_PIN);
	SPI_I2S_SendData(SPI2, data);
	while (SPI_I2S_GetFlagStatus(SPI2, SPI_I2S_FLAG_TXE) == RESET);
	while (SPI_I2S_GetFlagStatus(SPI2, SPI_I2S_FLAG_BSY) == SET);
	GPIO_SetBits(GPIOA, CS_PIN);
}

void init_CTRL_GPIO()
{
	GPIO_InitTypeDef GPIO_InitStructure;
	
	GPIO_InitStructure.GPIO_Pin = CS_PIN | DC_PIN | RST_PIN;
	GPIO_InitStructure.GPIO_Mode = GPIO_Mode_Out_PP;
	GPIO_InitStructure.GPIO_Speed = GPIO_Speed_50MHz;

	GPIO_Init(GPIOA, &GPIO_InitStructure);
}
void send_1Command_SSD1306(uint8_t command)
{
	GPIO_ResetBits(GPIOA, DC_PIN);
	send_data_SPI2(command);
	GPIO_SetBits(GPIOA, DC_PIN);
}

void send_2Command_SSD1306(uint8_t comm1,uint8_t comm2)
{
	GPIO_ResetBits(GPIOA, DC_PIN);
	send_data_SPI2(comm1);
	send_data_SPI2(comm2);
	GPIO_SetBits(GPIOA, DC_PIN);
}

void send_Data_SSD1306(uint8_t data)
{
	GPIO_SetBits(GPIOA, CS_PIN);
	GPIO_SetBits(GPIOA, DC_PIN);
	send_data_SPI2(data);
}

void init_SSD1306()
{
	GPIO_SetBits(GPIOA, RST_PIN);
	delay_MS(1);
	GPIO_ResetBits(GPIOA, RST_PIN);	
	delay_MS(10);
	GPIO_SetBits(GPIOA, RST_PIN);
	
	
	send_1Command_SSD1306(0x8D);
	//send_1Command_SSD1306(0x10);	//eXTERNAL VCC
	send_1Command_SSD1306(0x14);	//INTERNAL VCC
		
	send_1Command_SSD1306(0xAE);
	send_1Command_SSD1306(0xD5);
	send_1Command_SSD1306(0x80);
	send_1Command_SSD1306(0xA8);
	send_1Command_SSD1306(0x3F);
	send_1Command_SSD1306(0xD3);
	send_1Command_SSD1306(0x00);
	send_1Command_SSD1306(0x40);

	

	
	send_1Command_SSD1306(0x20);
	send_1Command_SSD1306(0x00);
	
	send_1Command_SSD1306(0xA0 | 0X1);
	
	send_1Command_SSD1306(0xC8);
	send_1Command_SSD1306(0xDA);
	send_1Command_SSD1306(0x12);
	send_1Command_SSD1306(0x81);
	
	//send_1Command_SSD1306(0x9F);	//eXTERNAL VCC
	send_1Command_SSD1306(0xCF);	//INTERNAL VCC
	
	
	send_1Command_SSD1306(0xD9);
	
	//send_1Command_SSD1306(0x22);	//eXTERNAL VCC
	send_1Command_SSD1306(0xF1);	//INTERNAL VCC
	
	send_1Command_SSD1306(0xDB);
	send_1Command_SSD1306(0x40);
	send_1Command_SSD1306(0xA4);
	send_1Command_SSD1306(0xA6);
	
	send_1Command_SSD1306(0xAF);	//DISPLAY ON
	
}

void display_SSD1306()
{
	uint16_t i;
	
	send_1Command_SSD1306(0x00);
	send_1Command_SSD1306(0x10);
	send_1Command_SSD1306(0x40);
	
	for(i = 0 ; i < 1024; i++)
	{
		send_Data_SSD1306(buffer[i]);
	}
	
}




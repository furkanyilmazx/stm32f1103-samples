#include "stm32f10x.h"
#include "stm32f10x_rcc.h"
#include "stm32f10x_gpio.h"
#include "stm32f10x_i2c.h"
#include "stm32f10x_spi.h"
#include "fyxI2C_Lib.h"


uint8_t receivedByte;



static uint8_t buffer[512] = {
0x00, 0x00, 0x00, 0x00, 0x00, 0x00, 0x00, 0x00, 0x00, 0x00, 0x00, 0x00, 0x00, 0x00, 0x00, 0x00,
0x00, 0x00, 0x00, 0x00, 0x00, 0x00, 0x00, 0x00, 0x00, 0x00, 0x00, 0x00, 0x00, 0x00, 0x00, 0x00,
0x00, 0x00, 0x00, 0x00, 0x00, 0x00, 0x00, 0x00, 0x00, 0x00, 0x00, 0x00, 0x00, 0x00, 0x00, 0x00,
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0x00, 0x00, 0x00, 0x00, 0x00, 0x00, 0x00, 0x00, 0x00, 0x00, 0x00, 0x00, 0x00, 0x00, 0x00, 0x00
};

static uint8_t buffer64[1024] = { 
0x00,0x00,0x00,0x00,0x00,0x00,0x00,0x00,0x00,0x00,0x00,0x00,0x00,0x00,0x00,0x00,
0x00,0x00,0x00,0x00,0x00,0x00,0x00,0x00,0x00,0x00,0x00,0x00,0x00,0x00,0x00,0x00,
0x00,0x00,0x00,0x00,0x00,0x00,0x00,0x00,0x00,0x00,0x00,0x00,0x00,0x00,0x00,0x00,
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0x00,0x00,0x00,0x00,0x00,0x00,0x00,0x00,0x00,0x00,0x00,0x00,0x00,0x00,0x00,0x00
};

void 	delay_MS(uint32_t nCount);
void	init_RCC(void);
void	init_SPI2(void);
void	init_CTRL_GPIO(void);
void	send_data_SPI2(uint8_t data);

void 	send_1Command_SSD1306(uint8_t command);
void 	send_2Command_SSD1306(uint8_t comm1,uint8_t comm2);
void 	send_Data_SSD1306(uint8_t data);
void 	init_SSD1306(void);
void	display_SSD1306(uint8_t *buff);
void	stopScroll_SSD1306(void);
void	startScrollRight_SSD1306(uint8_t start, uint8_t stop);
void	startDiagonalScrollRight_SSD1306(uint8_t start, uint8_t stop);
void	inverseDisplay_SSD1306(uint8_t inverseFlag);

int counter=0,timer=0;
void SysTick_Handler()
{
	if(counter == 1)
		GPIOB->ODR ^= 0x00000001;
	else if(counter == 2)
	{

		GPIOB->ODR ^= 0x00000003;
	}
		else if(counter == 3)
	{
		GPIOA->ODR ^= 0x00000001;
		GPIOB->ODR ^= 0x00000002;
	}
		else if(counter == 4)
	{
		GPIOA->ODR ^= 0x000000003;
	}
		else if(counter == 5)
	{
		GPIOA->ODR ^= 0x00000012;
	}
		else if(counter == 6)
	{
		GPIOA->ODR ^= 0x00000010;
		GPIOB->ODR ^= 0x00000020;
	}
			else if(counter == 7)
	{
		GPIOA->ODR ^= 0x00000100;
		GPIOB->ODR ^= 0x00000020;
	}
				else if(counter == 8)
	{
		GPIOA->ODR ^= 0x00000100;
		counter = 0;
	}
	

	counter++;
}

int main(void)
{
	GPIO_InitTypeDef myGPIO;
	SystemInit ();
	SystemCoreClockUpdate();
	
	
	
	fyx_init_RCC();
	fyx_init_CTRL_GPIO();
	fyx_init_I2C();
	fyx_init_CTRL_GPIO();

	fyx_init_SSD1306();
		init_SPI2();
	init_SSD1306();
		display_SSD1306(buffer64);
	fyx_display_SSD1306(buffer);
	fyx_startScrollRight_SSD1306(0x00,0x07);
	startScrollRight_SSD1306(0x04,0x07);
	inverseDisplay_SSD1306(1);
	
	
		RCC_APB2PeriphClockCmd(RCC_APB2Periph_GPIOB,ENABLE);
	
	myGPIO.GPIO_Pin = GPIO_Pin_0 | GPIO_Pin_1| GPIO_Pin_5;
	myGPIO.GPIO_Speed = GPIO_Speed_50MHz;
	myGPIO.GPIO_Mode = GPIO_Mode_Out_PP;
	
	GPIO_Init(GPIOB,&myGPIO);

	
	myGPIO.GPIO_Pin = GPIO_Pin_1 | GPIO_Pin_0 |GPIO_Pin_4|GPIO_Pin_8 ;
	
	GPIO_Init(GPIOA,&myGPIO);
	SysTick_Config(450000);
	
	while (1)
	{
	}
}


void init_SPI2()
{
	GPIO_InitTypeDef GPIO_InitStructure;
	SPI_InitTypeDef  SPI_InitStructure;

	/* SPI2 GPIO configuration -------------------------------------------------------*/
	GPIO_InitStructure.GPIO_Mode = GPIO_Mode_AF_PP;
	GPIO_InitStructure.GPIO_Speed = GPIO_Speed_50MHz;
	GPIO_InitStructure.GPIO_Pin = GPIO_Pin_13 | GPIO_Pin_15;
	GPIO_Init(GPIOB, &GPIO_InitStructure);

	
	/* SPI2 configuration -------------------------------------------------------*/
	SPI_InitStructure.SPI_Direction 		= SPI_Direction_1Line_Tx;
	SPI_InitStructure.SPI_DataSize 			= SPI_DataSize_8b;
	SPI_InitStructure.SPI_CPOL 				= SPI_CPOL_High;
	SPI_InitStructure.SPI_CPHA 				= SPI_CPHA_2Edge;
	SPI_InitStructure.SPI_NSS 				= SPI_NSS_Soft;
	SPI_InitStructure.SPI_BaudRatePrescaler = SPI_BaudRatePrescaler_32;
	SPI_InitStructure.SPI_FirstBit 			= SPI_FirstBit_MSB;
	
	SPI_InitStructure.SPI_Mode 				= SPI_Mode_Master;
	
	
	SPI_Init(SPI2, &SPI_InitStructure);
	
	SPI_Cmd(SPI2, ENABLE);
}

void send_data_SPI2(uint8_t data)
{
	GPIO_ResetBits(GPIOC, CS_PIN);
	SPI_I2S_SendData(SPI2, data);
	while (SPI_I2S_GetFlagStatus(SPI2, SPI_I2S_FLAG_TXE) == RESET);
	while (SPI_I2S_GetFlagStatus(SPI2, SPI_I2S_FLAG_BSY) == SET);
	GPIO_SetBits(GPIOC, CS_PIN);
}

void init_CTRL_GPIO()
{
	GPIO_InitTypeDef GPIO_InitStructure;
	
	GPIO_InitStructure.GPIO_Pin = CS_PIN | DC_PIN | RST_PIN;
	GPIO_InitStructure.GPIO_Mode = GPIO_Mode_Out_PP;
	GPIO_InitStructure.GPIO_Speed = GPIO_Speed_50MHz;

	GPIO_Init(GPIOC, &GPIO_InitStructure);
}
void send_1Command_SSD1306(uint8_t command)
{
	GPIO_ResetBits(GPIOC, DC_PIN);
	send_data_SPI2(command);
	GPIO_SetBits(GPIOC, DC_PIN);
}

void send_2Command_SSD1306(uint8_t comm1,uint8_t comm2)
{
	GPIO_ResetBits(GPIOC, DC_PIN);
	send_data_SPI2(comm1);
	send_data_SPI2(comm2);
	GPIO_SetBits(GPIOC, DC_PIN);
}

void send_Data_SSD1306(uint8_t data)
{
	GPIO_SetBits(GPIOC, CS_PIN);
	GPIO_SetBits(GPIOC, DC_PIN);
	send_data_SPI2(data);
}

void powerOnReset_SSD1306()
{
	GPIO_SetBits(GPIOC, RST_PIN);
	fyx_delay_MS(1);
	GPIO_ResetBits(GPIOC, RST_PIN);	
	fyx_delay_MS(10);
	GPIO_SetBits(GPIOC, RST_PIN);
}

void init_SSD1306()
{

	powerOnReset_SSD1306();
	
		
	send_1Command_SSD1306(0xAE);
	send_1Command_SSD1306(0xD5);
	send_1Command_SSD1306(0x80);
	
	send_1Command_SSD1306(0xA8);
	send_1Command_SSD1306(0x3F);
	
	send_1Command_SSD1306(0xD3);
	send_1Command_SSD1306(0x00);
		
	send_1Command_SSD1306(0x40);
	
	send_1Command_SSD1306(0x8D);
	//send_1Command_SSD1306(0x10);	//eXTERNAL VCC
	send_1Command_SSD1306(0x14);	//INTERNAL VCC
	
	send_1Command_SSD1306(0x20);
	send_1Command_SSD1306(0x00);
	
	send_1Command_SSD1306(0xA1);
	
	send_1Command_SSD1306(0xC8);
		
	send_1Command_SSD1306(0xDA);
	send_1Command_SSD1306(0x12);
	
	send_1Command_SSD1306(0x81);
	//send_1Command_SSD1306(0x9F);	//eXTERNAL VCC
	send_1Command_SSD1306(0xCF);	//INTERNAL VCC
		
	
	send_1Command_SSD1306(0xD9);
	//send_1Command_SSD1306(0x22);	//eXTERNAL VCC
	send_1Command_SSD1306(0xF1);	//INTERNAL VCC
	
	send_1Command_SSD1306(0xDB);
	send_1Command_SSD1306(0x40);
	
	send_1Command_SSD1306(0xA4);
	
	send_1Command_SSD1306(0xA6);
		
	send_1Command_SSD1306(0xAF);	//DISPLAY ON
	
	send_1Command_SSD1306(0x2E); 	//deactivescrool
}

void display_SSD1306(uint8_t *buff)
{
	uint16_t i;
	
	send_1Command_SSD1306(0x00);
	send_1Command_SSD1306(0x10);
	send_1Command_SSD1306(0x40);
	
	for(i = 0 ; i < 1024; i++)
	{
		send_Data_SSD1306(buff[i]);
	}
	
}
void stopScroll_SSD1306()
{
	send_1Command_SSD1306(0x2E);
}
void startScrollRight_SSD1306(uint8_t start, uint8_t stop)
{
	send_1Command_SSD1306(0x26);
	send_1Command_SSD1306(0x00);
	send_1Command_SSD1306(start);
	send_1Command_SSD1306(0x07);	//speed
	send_1Command_SSD1306(stop);
	send_1Command_SSD1306(0x00);
	send_1Command_SSD1306(0xFF);
	send_1Command_SSD1306(0x2F);
}

void startDiagonalScrollRight_SSD1306(uint8_t start, uint8_t stop)
{
	send_1Command_SSD1306(0xA3);
	send_1Command_SSD1306(0x00);
	send_1Command_SSD1306(64);
	send_1Command_SSD1306(0x29);
	send_1Command_SSD1306(0x00);
	send_1Command_SSD1306(start);
	send_1Command_SSD1306(0x00);
	send_1Command_SSD1306(stop);
	send_1Command_SSD1306(0x01);
	send_1Command_SSD1306(0x2F);
}

void inverseDisplay_SSD1306(uint8_t inverseFlag)
{
	if(inverseFlag == 1)
			send_1Command_SSD1306(0xA7);
	else
			send_1Command_SSD1306(0xA6);
}

